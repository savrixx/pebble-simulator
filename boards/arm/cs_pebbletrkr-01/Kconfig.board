## boards/arm/cs_pebbletrkr-01/Kconfig.board
```kconfig
# Copyright (c) 2022 Nordic Semiconductor ASA
# SPDX-License-Identifier: Apache-2.0

config BOARD_CS_PEBBLETRKR_01
	bool "IOTEX"
	depends on SOC_NRF9160_SICA
```

## boards/arm/cs_pebbletrkr-01/Kconfig.defconfig
```kconfig
# Copyright (c) 2022 Nordic Semiconductor ASA
# SPDX-License-Identifier: Apache-2.0

if BOARD_CS_PEBBLETRKR_01

config BOARD
	default "cs_pebbletrkr-01"


endif
```
